## meta-phlagg/conf/layer.conf
```bitbake
BBPATH .= ":${LAYERDIR}"

BBFILES += "${LAYERDIR}/recipes-*/*/*.bb \
            ${LAYERDIR}/recipes-*/*/*.bbappend"

BBFILE_COLLECTIONS += "meta-phlagg"
BBFILE_PATTERN_meta-phlagg = "^${LAYERDIR}/"
BBFILE_PRIORITY_meta-phlagg = "6"
LAYERSERIES_COMPAT_meta-phlagg = "scarthgap"
```
